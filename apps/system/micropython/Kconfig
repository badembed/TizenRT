## apps/system/micropython/Kconfig
```kconfig
#
# For a description of the syntax of this configuration file,
# see the file kconfig-language.txt in the NuttX tools repository.
#

config INTERPRETERS_MICROPYTHON
	bool "Micro Python support"
	default n
	---help---
		Enable support for the Micro Python interpreter

if INTERPRETERS_MICROPYTHON

config INTERPRETERS_MICROPYTHON_PROGNAME
	string "Program name"
	default "micropython"
	depends on BUILD_KERNEL

endif # INTERPRETERS_MICROPYTHON
```
